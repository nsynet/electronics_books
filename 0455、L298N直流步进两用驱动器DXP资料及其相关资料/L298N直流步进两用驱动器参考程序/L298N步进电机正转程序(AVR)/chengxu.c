////////////////////////汇诚科技////////////////////
//////////////////http://www.ourhc.cn///////////////
///////////////////步进电机正转调试程序/////////////
#include <iom16v.h>
#include <macros.h>

/*------宏定义------*/
#define uchar unsigned char
#define uint unsigned int
uchar run[8]={0x0e,0x0c,0x0d,0x09,0x0b,0x03,0x07,0x06};  //两相四线八拍工作方式数组
/*******************************************************************
                             端口初始化
*******************************************************************/
void port_init(void)
{
 PORTB = 0xFF;
 DDRB  = 0xFF;
 }
/*******************************************************************
                             延时函数
*******************************************************************/
void delay(uint i)//延时函数
{
uint j,k;
for(j=0;j<i;j++)
for(k=0;k<1000;k++);
}
/*******************************************************************
                             主函数
*******************************************************************/
main()
{
uint z,y;
y=40;	    //定义延时时间，时间越长电机转速越慢反之则快
port_init();
while(1)
{
for(z=0;z<8;z++)  //改变数组的长度值需改变这个数字8，8为数组的长度。
{
PORTB=run[z];
delay(y);
}
}
}