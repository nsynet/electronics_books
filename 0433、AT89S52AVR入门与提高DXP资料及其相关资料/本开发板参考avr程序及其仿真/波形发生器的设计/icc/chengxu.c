#include <iom16v.h> 
#define uchar unsigned char 
#define uint unsigned int
uchar duan[10]={0x3f,0x06,0x5b,0x4f,0x66,0x6d,0x7d,0x07,0x7f,0x6f};	 //所需的段的位码
//uchar wei[4]={0XFE,0XFD,0XFB,0XF7}; //位的控制端	(开发板)
uchar wei[4]={0X0e,0X0d,0X0b,0X07};   //位的控制端	(仿真)
uchar Key1_Flag,Key2_Flag,Key3_Flag;  //按键控制频率加减复位                          
uint z,x,c,v, date;	//定义数据类型
uint date=1;        //频率初始值1K
/******************************************************************
延时函数
******************************************************************/
void delay(uchar t)
{
  uchar i,j;
   for(i=0;i<t;i++)
   {
   	 for(j=13;j>0;j--);
	 { ; }
   }
}
/**********************************************************************
                数码管动态扫描
*********************************************************************/
void xianshi()
 { 
 uint i,j;
 /*************************数据转换*****************************/ 
  z=date/1000;			 //求千位
  x=date%1000/100;		 //求百位
  c=date%100/10;		 //求十位
  v=date%10;			 //求个位
 /*****************设置比较寄存器值*****************************/ 
 i=z*1000+x*100+c*10+v;
 j=500/i;
 OCR1AH=j>>8;
 OCR1AL=j&0x00ff;
 /********************数码管扫描显示****************************/ 

      PORTC=wei[0];
	  PORTA=duan[z];
	  delay(50);  
  	  PORTC=wei[1];
      PORTA=duan[x];
	  delay(50);  
   	  PORTC=wei[2];
      PORTA=duan[c];
	  delay(50);  
      PORTC=wei[3];
      PORTA=duan[v];
	  delay(50);  
 	}
/**********************************************************************
                          频率调节按键控制
*********************************************************************/
void Key_Process()
{
 while((PINB&0x01)==0) {xianshi();Key1_Flag=1;}
 while((PINB&0x02)==0) {xianshi();Key2_Flag=1;}
 while((PINB&0x04)==0) {xianshi();Key3_Flag=1;}
 if(Key1_Flag==1) //处理频率百位，最高4
   {
    date++;//设置频率值加
	if(date>=30) date=30;//设置最大值为30KHZ
	Key1_Flag=0;
	}   
 if(Key2_Flag==1) //处理频率十位，最高9
    {
	if(date<=0) date=1;  //设置最大值为0HZ
	date--;//设置频率值减
	Key2_Flag=0;
	 }
 if(Key3_Flag==1) //处理频率各位，最高9
    {
	date=1;//设置频率复位
	Key3_Flag=0;
	 }
}
/******************************************************************

/**********************************************************************
                         初始化I/O口
*********************************************************************/
void Init_IO(void)             //初始化I/O口
{DDRA=0xff;                    //设置A口为推挽1输出
 PORTA=0xff;
 DDRC=0xff;                    //设置C口为推挽1输出             
 PORTC=0xff;
 DDRB=0x00;                    //设置B口为三态输入
 PORTB=0x00;
 DDRD=0xff;                    //设置D口为推挽1输出
 PORTD=0xff;    
}
/**********************************************************************
                         初始化I/O口
*********************************************************************/
void Init_Timer1(void)         //初始化T/C1的输入捕获中断
{TIMSK=TIMSK|0x10;             //输出比较使能
 TCCR1B=0x0a;                  //时钟1频,输出比较匹配清除定时器值
 TCNT1H=0x00;                  //清除定时器值
 TCNT1L=0x00;
 SREG=SREG|0x80;               //全局中断开
} 
/**********************************************************************
                          主函数
*********************************************************************/
void main(void)
{
 Init_IO(); //初始化I/O口
 xianshi(); //显示初始值
 Init_Timer1();//初始化T/C1的输入捕获中断 
 
 while(1)
 {

Key_Process();//按键值函数
xianshi();//频率值显示

 }
}
/**********************************************************************
                          中断服务函数
*********************************************************************/
#pragma interrupt_handler Compare:7
void Compare(void)
{
PORTD=~PORTD;//PD口输出
}