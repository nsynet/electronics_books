/********************************************************************
                            汇诚科技
					  http://www.ourhc.cn
*********************************************************************/
#include<reg52.h>  	       //库文件
#define uchar unsigned char//宏定义无符号字符型
#define uint unsigned int  //宏定义无符号整型
/********************************************************************
                            初始定义
*********************************************************************/
code uchar seg7code[10]={ 0xc0,0xf9,0xa4,0xb0,0x99,0x92,0x82,0xf8,0x80,0x90}; //显示段码 数码管字跟
uchar wei[4]={0XEf,0XDf,0XBf,0X7f};                                 //位的控制端
/********************************************************************
                            延时函数
*********************************************************************/
void delay(uchar t)
{
  uchar i,j;
   for(i=0;i<t;i++)
   {
   	 for(j=13;j>0;j--);
	 { ;
	 }
   }
}

/********************************************************************
                            显示函数
*********************************************************************/        
void Led(int date) //显示函数
{
/*****************数据转换*****************************/ 
 uint z,x,c,v;
  z=date/1000;			 //求千位
  x=date%1000/100;		 //求百位
  c=date%100/10;		 //求十位
  v=date%10;			 //求个位

      P2=0XFF;
	  P0=seg7code[z];
	  P2=wei[0];
	  delay(80);
	  P2=0XFF;  
      P0=seg7code[x];
	  P2=wei[1];
	  delay(80);
	  P2=0XFF;  
   	  P0=seg7code[c];
	  P2=wei[2];
	  delay(80);
	  P2=0XFF;  
      P0=seg7code[v];
	  P2=wei[3];
	  delay(80); 
	  P2=0XFF;
}

/********************************************************************
                            主函数
*********************************************************************/
void main()
{
{
int display_date=1358; //定义并赋值要显示的数据
while(1)
{
Led(display_date);//调用显示函数显示数据display_date
}
}
}

	
/********************************************************************
                              结束
*********************************************************************/
