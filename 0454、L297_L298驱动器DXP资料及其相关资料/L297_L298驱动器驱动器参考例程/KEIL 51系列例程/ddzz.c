
////////////////////////汇诚科技////////////////////
//////////////////http://www.ourhc.cn///////////////
///////////////////步进电机调试程序/////////////

#include<reg52.h>  
#define uchar unsigned char//宏定义无符号字符型
#define uint unsigned int  //宏定义无符号整型

sbit CW=P1^0;	//控制步进电机的方向
sbit H_F=P1^1;	//控制步进电机的工作方式（1为四拍工作方式，0为八拍工作方式）
sbit CLK=P1^2;	//控制步进电机的转动速度，一个脉冲电机转动一个步进角。
sbit RES=P1^3;	//使能控制(为1时电机运行，为0时电机停止)

/*********************************************************************/
void delay(uint i)//延时函数
{
uint j,k;
for(j=0;j<i;j++)
for(k=0;k<150;k++);
}
/*********************************主函数************************************/
main()
{
	CW=1;  //为1时电机正转，为0时电机反转
	H_F=0; //1为四拍工作方式，0为八拍工作方式
	CLK=1; //脉冲输出初始值
	RES=1; //为1时电机运行，为0时电机停止
while(1)
	{
		CLK=!CLK; //产生脉冲
		delay(1); //控制速度（改变括号内的阿拉伯数字可以改变转速）《数字越小电机转动越快》
	}
}
