#include <iom8v.h>
#define uchar unsigned char 
#define uint unsigned int

//CW控制步进电机的方向
//H_F控制步进电机的工作方式（1为四拍工作方式，0为八拍工作方式）
//CLK控制步进电机的转动速度，一个脉冲电机转动一个步进角。
//RES使能控制(为1时电机运行，为0时电机停止)

/******************************************************************
延时函数
******************************************************************/
void delay(uint t)
{
  uint i,j;
   for(i=0;i<t;i++)
   {
   	 for(j=800;j>0;j--);
	 { ;
	 }
   }
}
/***********************************初始化*****************************/
void Init_IO(void)//初始化I/O
{
//设置B口为输出
DDRB=0xff;
PORTB=0xff;
//设置C口为输出
DDRC=0xff;
PORTC=0xff;
//设置D口为输入
DDRD=0X00;
PORTD=0x00;
}
 /*************************************************************************
                                主函数	
**************************************************************************/
 void main()
{  
    Init_IO();
 while(1)
	{	

	PORTC=0xFF;//PC口控制电机的工作方式；方向；使能
	
	/************PB口输出控制电机的转速****************/
	PORTB=0xff;
	delay(10);
	PORTB=0x00;
	delay(10);
	/****************************/
    }

}					
///////////////////////////////////////////////////////////////////

