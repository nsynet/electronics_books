/*
 ----------------------------------------------------
 *作    者：温子祺
 ----------------------------------------------------
 */

#include "stc.h"           //加载"stc.h"头文件
/****************************************
*函数名称:Delay
*输    入:无
*输    出:无
*功    能:延时一小段时间 
******************************************/ 
void Delay(void)           //定义Delay函数,延时500ms
{
	unsigned char i,j;     //声明变量i,j

	for(i=0;i<255;i++)     //进行循环操作,以达到延时的效果
		for(j=0;j<255;j++);

	for(i=0;i<255;i++)	   //进行循环操作,以达到延时的效果
		for(j=0;j<255;j++);

	for(i=0;i<255;i++)     //进行循环操作,以达到延时的效果
		for(j=0;j<140;j++);
}
/****************************************
*函数名称:UARTInit
*输    入:无
*输    出:无
*功    能:串口初始化
******************************************/
void UARTInit(void)        //定义串口初始化函数
{
     SCON =0x40;             //8位数据位
	T2CON=0x34;             //由T/C2作为波特率发生器
	RCAP2L=0xD9;            //波特率为9600的低8位
	RCAP2H=0xFF;            //波特率为9600的高8位
}
/****************************************
*函数名称:UARTSendByte
*输    入:byte 要发送的字节
*输    出:无
*功    能:串口发送单个字节
******************************************/
void UARTSendByte(unsigned char byte)
{
	SBUF=byte;              //缓冲区装载要发送的字节
	while(TI==0);          //等待发送完毕,TI标志位会置1
	TI=0;                    //清零发送中断标志位
}
/****************************************
*函数名称:main
*输    入:无
*输    出:无
*功    能:函数主体
******************************************/
void main(void)            
{
	unsigned char i=0;    //声明变量i

	UARTInit();            //串口初始化

	while(1)                //进入死循环
	{
		UARTSendByte(i);  //串口发送单字节数据
		Delay();            //延时500ms
		i++;                 //i自加1
		if(i>255)i=0;      //若i>255,i=0
	}
}

