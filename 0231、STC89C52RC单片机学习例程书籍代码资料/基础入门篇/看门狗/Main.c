/*
 ----------------------------------------------------
 *作    者：温子祺
 ----------------------------------------------------
 */

#include "stc.h"           

#define LED_PORT     P2  //定义LED控制端口为P2口

/********************************************
*函数名称:Delay
*输    入:无
*输    出:无
*说    明:延时一段时间
********************************************/
void Delay(void)          
{
	unsigned char i,j;   

	for(i=0;i<130;i++)     
		for(j=0;j<255;j++);
}
/********************************************
*函数名称:WDTInit
*输    入:无
*输    出:无
*说    明:看门狗初始化
********************************************/
void WDTInit(void)
{
     WDT_CONTR=0x35;//使能看门狗，预分频64
}
 
/********************************************
*函数名称:WDTFeed
*输    入:无
*输    出:无
*说    明:喂狗操作
********************************************/
void WDTFeed(void)
{
     WDT_CONTR=0x35;
}
/********************************************
*函数名称:EXTInit
*输    入:无
*输    出:无
*说    明:外部中断初始化
********************************************/
void EXTInit(void)
{
     EX1=1;        //允许外部中断1中断
     IT1=0;        //低电平触发
     EA=1;         //开启全局中断
}
/********************************************
*函数名称:main
*输    入:无
*输    出:无
*说    明:函数
********************************************/
void main(void)            
{
    unsigned char i;
		
	for(i=0;i<20;i++)      //循环闪烁LED灯
	{
	   LED_PORT=~LED_PORT;

	   Delay();
	   
	}

	WDTInit();             //初始化看门狗
    EXTInit();             //外部中断初始化

	while(1);               //让看门狗定时器溢出复位	

}
/********************************************
*函数名称:EXT1IRQ
*输    入:无
*输    出:无
*说    明:外部中断1中断服务函数 喂狗
********************************************/
void EXT1IRQ(void)interrupt 2
{
     
     WDTFeed(); //喂狗

}

