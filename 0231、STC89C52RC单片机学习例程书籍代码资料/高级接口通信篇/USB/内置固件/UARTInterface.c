/************************************************************************
*作    者:温子祺 邮箱:k125008301@126.com
*文    件:UARTInterface.c
--------------------------------------------------------------
*说    明:定义串口硬件接口层
*修改日期:2009/12/02
--------------------------------------------------------------
*创建日期:2009/11/30
*说    明:
--------------------------------------------------------------
*************************************************************************/
#include "stc.h"
#include "global.h"
#include "UARTHardware.h"
#include "UARTInterface.h"
/****************************************************************************************************
*
*                                      变量区
* 
*****************************************************************************************************/


/****************************************************************************************************
*
*                                      函数区
* 
*****************************************************************************************************/
/******************************************************************
*函数名称:UARTSendByte
*输    入:b
*输    出:无
*说    明:串口 发送单字节
*******************************************************************/
static
void UARTSendByte(UINT8 b)
{
 	 SBUF=b;
	 while(TI==0);
	 TI=0;
}
/******************************************************************
*函数名称:UARTSendByte
*输    入:b
*输    出:无
*说    明:串口 发送单字节
*******************************************************************/
void UARTCiSendNBytes(UINT8 *buf,UINT8 len)
{
	 if(buf == NULL || len ==0 )return;

     while(len--)
     {
        UARTSendByte(*buf++);
     }
}
/******************************************************************
*函数名称:UARTCiPrintfString
*输    入:b
*输    出:无
*说    明:串口 发送字符串
*******************************************************************/
void UARTCiPrintfString(const INT8 *str)
{
     while(str && *str)
     {
     
        UARTSendByte(*str++); 
               
     }

}
/******************************************************************
*函数名称:UARTSendByte
*输    入:b
*输    出:无
*说    明:串口 发送单字节
*******************************************************************/
void UARTCiPrintfVal(UINT8 *str,UINT32 val,UINT8 show)
{    
     UINT8 i=0;
     UINT8 buf[10]={0}; 
     
	 UARTCiPrintfString(str);

     if(10 == show)
     {
         for(i=0; i<10 ;i++)
         {
             buf[i]=(UINT8)('0'+val%10);   
             val/=10;   
         } 
     
         
         for(i=9;i>=0;)
         {
             if('0' == buf[i])
             {
                 i--;
             }
             else
             {
                break;
             }
         } 
         
         while(1)
         {    
             
             UARTSendByte(buf[i]); 
             
             if(!i)
             {
                 break; 
             } 
             
             i--;
         } 
         
         
     }
     
     if(16 == show)
     {
        UARTSendByte('0');
	    UARTSendByte('x');
	    
        i=28;
        
        while(i)
        {
            if(0  == ((val>>i) &0x0f))
            {   
                i=i-4;
               
            }
            else
            {
                break;
            }
        } 
        
        while(1)
        {
            UARTSendByte(HexTable[(val>>i) &0x0f]); 
            
            if(!i)
            {
                break; 
            }     
                    
            i=i-4;
        }  
        
     } 
     
     UARTCiPrintfString("\r\n");
}
/******************************************************************
*函数名称:UARTCiInit
*输    入:无
*输    出:无
*说    明:串口 初始化
*******************************************************************/
void UARTCiInit(void)
{
	UARTHwInit();
}
