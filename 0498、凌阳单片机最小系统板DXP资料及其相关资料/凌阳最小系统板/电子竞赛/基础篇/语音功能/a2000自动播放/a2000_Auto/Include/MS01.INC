// Progarm: SACM-MS01 API external definition
// Writen by: Andy
// Date: 2000/06/20
// Update: 2001/02/10
//////////////////////////////////////////////////////////////////////////////////////////
.external F_SACM_MS01_Initial;
.external F_SACM_MS01_ServiceLoop;
.external F_SACM_MS01_Play;
.external F_SACM_MS01_Stop;
.external F_SACM_MS01_Pause;
.external F_SACM_MS01_Resume;

.external F_SACM_MS01_VolumeUp;
.external F_SACM_MS01_VolumeDn;
	
.external F_SACM_MS01_SpeechStatus;

.external F_SACM_MS01_PcPlayInitial;

.external F_FIQ_Service_SACM_MS01;
.external F_IRQ2_Service_SACM_MS01;
.external F_IRQ4_Service_SACM_MS01;

.external F_SACM_MS01_ChannelOff;
.external F_SACM_MS01_ChannelOn;
.external F_SACM_MS01_SetInstrument;

//========================================================================================        
// End of MS01.inc
//========================================================================================
