//////////////////////////////////////////////////////////////////////////////////////////
// Progarm: SACM_S240 API external definition
// Writen by: JohnWu
// Date: 2000/07/25
//		 2001/02/10
//////////////////////////////////////////////////////////////////////////////////////////

.external F_SACM_S240_Initial;
.external F_SACM_S240_ServiceLoop;
.external F_SACM_S240_Play;
.external F_SACM_S240_Stop;
.external F_SACM_S240_Pause;
.external F_SACM_S240_Resume;

.external F_SACM_S240_VolumeUp;
.external F_SACM_S240_VolumeDn;
	
.external F_SACM_S240_SpeechStatus;

.external F_SACM_S240_PcPlayInitial;

.external F_FIQ_Service_SACM_S240;

   
//========================================================================================        
// End of S240.inc
//========================================================================================
        