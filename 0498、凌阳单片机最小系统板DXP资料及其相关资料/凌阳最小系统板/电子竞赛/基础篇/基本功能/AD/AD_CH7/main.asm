//*****************************************************************************/
// 描述： 通过7路AD转换，结果存至相应存储单元
//        采用读取P_ADC_MUX_DATA寄存器启动ADC转换。
// 日期： 2003/07/09
// 版本:  1.8.0
//*****************************************************************************/
.DEFINE		P_INT_Ctrl		    0x7010 
.DEFINE		P_INT_CLEAR			0x7011 
.DEFINE		P_ADC_Ctrl		    0x7015 
.DEFINE		P_ADC_MUX_Ctrl		0x702b 
.DEFINE		P_ADC_MUX_DATA		0x702C
.DEFINE		P_DAC_Ctrl		    0x702A 
.DEFINE     P_WATCHDOG_CLEAR    0x7012
.ISRAM		
.PUBLIC		chanal_data           //声明全局变量
chanal_data:
   .DW 7 DUP(?)                 //预留7个整型的数据单元
.CODE
.PUBLIC _main
//============================================================================= 
// 函数： main()
// 描述：主函数
//=============================================================================

_main: 
    R1 = 0x0013                //允许A/D转换,LINE_IN输入
    [P_ADC_Ctrl] = R1 
L_Clear:
    R2 = 0x0000                 
    R3=chanal_data
L_Chanal:
    CMP R2, 0x0007
    JE L_Clear
    R2+=1                        //通道计数器加1
    [P_ADC_MUX_Ctrl] = R2
    call L_AD
    [R3++]=R1             		 //触发A/D重新转换
     R1=0  
L_DelayLoop:                    //延时
 	R4 = 0x0001;                      
	[P_WATCHDOG_CLEAR] = R4;	   		
    R1+=2  
    JNZ L_DelayLoop 
    JMP L_Chanal
//*******************************************************************************/
//转换子程序
//*******************************************************************************/   
L_AD: 	 
    R1 = [P_ADC_MUX_Ctrl]        //读寄存器[P_ADC_MUX_Ctrl]的B15位
    TEST R1,0x8000               //判断是否转换完毕
  JZ L_AD                      //否，继续转换    
    R1 = [P_ADC_MUX_DATA]        //是，则读出[P_ADC_MUX_DATA]转换结果 
    retf
//*****************************************************************************/
//  main.asm 结束
//*****************************************************************************/	