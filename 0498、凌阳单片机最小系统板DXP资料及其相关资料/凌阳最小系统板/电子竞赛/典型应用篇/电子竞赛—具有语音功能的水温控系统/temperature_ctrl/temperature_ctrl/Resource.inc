
// Resource Table
// Created by IDE, Do not modify this table

.TEXT
.external _RES_Table;
.external _RES_T034_16K_SA;
.external _RES_T034_16K_EA;
.external _RES_T046_16K_SA;
.external _RES_T046_16K_EA;
.external _RES_T047_16K_SA;
.external _RES_T047_16K_EA;
.external _RES_T048_16K_SA;
.external _RES_T048_16K_EA;
.external _RES_T049_16K_SA;
.external _RES_T049_16K_EA;
.external _RES_T050_16K_SA;
.external _RES_T050_16K_EA;
.external _RES_T051_16K_SA;
.external _RES_T051_16K_EA;
.external _RES_T052_16K_SA;
.external _RES_T052_16K_EA;
.external _RES_T053_16K_SA;
.external _RES_T053_16K_EA;
.external _RES_T054_16K_SA;
.external _RES_T054_16K_EA;
.external _RES_T055_16K_SA;
.external _RES_T055_16K_EA;
.external _RES_T056_16K_SA;
.external _RES_T056_16K_EA;

// End Table
