
// Resource Table
// Created by IDE, Do not modify this table

.TEXT
.external _RES_Table;
.external _RES_T022_48K_SA;
.external _RES_T022_48K_EA;
.external _RES_T023_48K_SA;
.external _RES_T023_48K_EA;
.external _RES_T024_48K_SA;
.external _RES_T024_48K_EA;
.external _RES_T025_48K_SA;
.external _RES_T025_48K_EA;
.external _RES_T026_48K_SA;
.external _RES_T026_48K_EA;
.external _RES_T027_48K_SA;
.external _RES_T027_48K_EA;
.external _RES_T028_48K_SA;
.external _RES_T028_48K_EA;
.external _RES_T029_48K_SA;
.external _RES_T029_48K_EA;
.external _RES_T030_48K_SA;
.external _RES_T030_48K_EA;
.external _RES_T031_48K_SA;
.external _RES_T031_48K_EA;
.external _RES_T066_48K_SA;
.external _RES_T066_48K_EA;
.external _RES_T016_48K_SA;
.external _RES_T016_48K_EA;

// End Table
