
// Resource Table
// Created by IDE, Do not modify this table

.TEXT
.external _RES_Table;
.external _RES_9_72K_SA;
.external _RES_9_72K_EA;
.external _RES_10_72K_SA;
.external _RES_10_72K_EA;
.external _RES_11_72K_SA;
.external _RES_11_72K_EA;
.external _RES_12_72K_SA;
.external _RES_12_72K_EA;
.external _RES_13_72K_SA;
.external _RES_13_72K_EA;
.external _RES_14_72K_SA;
.external _RES_14_72K_EA;
.external _RES_15_72K_SA;
.external _RES_15_72K_EA;
.external _RES_16_72K_SA;
.external _RES_16_72K_EA;
.external _RES_17_72K_SA;
.external _RES_17_72K_EA;
.external _RES_18_72K_SA;
.external _RES_18_72K_EA;
.external _RES_19_72K_SA;
.external _RES_19_72K_EA;
.external _RES_2_72K_SA;
.external _RES_2_72K_EA;
.external _RES_20_72K_SA;
.external _RES_20_72K_EA;
.external _RES_21_72K_SA;
.external _RES_21_72K_EA;
.external _RES_22_72K_SA;
.external _RES_22_72K_EA;
.external _RES_3_72K_SA;
.external _RES_3_72K_EA;
.external _RES_4_72K_SA;
.external _RES_4_72K_EA;
.external _RES_5_72K_SA;
.external _RES_5_72K_EA;
.external _RES_6_72K_SA;
.external _RES_6_72K_EA;
.external _RES_7_72K_SA;
.external _RES_7_72K_EA;
.external _RES_8_72K_SA;
.external _RES_8_72K_EA;
.external _RES_1_72K_SA;
.external _RES_1_72K_EA;

// End Table
