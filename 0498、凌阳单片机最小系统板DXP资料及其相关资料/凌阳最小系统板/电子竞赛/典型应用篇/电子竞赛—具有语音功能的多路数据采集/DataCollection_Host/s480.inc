//////////////////////////////////////////////////////////////////////////////////////////
// Progarm: SACM-S480 API external definition
// Writen by: Andy
// Date: 2000/06/20
//			2001/02/10
//////////////////////////////////////////////////////////////////////////////////////////
.external F_SACM_S480_Initial;
.external F_SACM_S480_ServiceLoop;
.external F_SACM_S480_Play;
.external F_SACM_S480_Stop;
.external F_SACM_S480_Pause;
.external F_SACM_S480_Resume;




.external F_SACM_S480_VolumeUp;
.external F_SACM_S480_VolumeDn;
	
.external F_SACM_S480_SpeechStatus;
.external F_FIQ_Service_SACM_S480;
.external F_SACM_S480_PcPlayInitial;

.external F_SACM_S480_Decode;
.external F_SACM_S480_FillQueue;
.external F_SACM_S480_TestQueue;
.external F_SACM_S480_InitDecode;
 


//========================================================================================        
// End of S480.inc
//========================================================================================
