
// Resource Table
// Created by IDE, Do not modify this table

.TEXT
.external _RES_Table;
.external _RES_9_48K_SA;
.external _RES_9_48K_EA;
.external _RES_1_48K_SA;
.external _RES_1_48K_EA;
.external _RES_10_48K_SA;
.external _RES_10_48K_EA;
.external _RES_11_48K_SA;
.external _RES_11_48K_EA;
.external _RES_12_48K_SA;
.external _RES_12_48K_EA;
.external _RES_13_48K_SA;
.external _RES_13_48K_EA;
.external _RES_14_48K_SA;
.external _RES_14_48K_EA;
.external _RES_15_48K_SA;
.external _RES_15_48K_EA;
.external _RES_16_48K_SA;
.external _RES_16_48K_EA;
.external _RES_17_48K_SA;
.external _RES_17_48K_EA;
.external _RES_18_48K_SA;
.external _RES_18_48K_EA;
.external _RES_19_48K_SA;
.external _RES_19_48K_EA;
.external _RES_2_48K_SA;
.external _RES_2_48K_EA;
.external _RES_20_48K_SA;
.external _RES_20_48K_EA;
.external _RES_21_48K_SA;
.external _RES_21_48K_EA;
.external _RES_22_48K_SA;
.external _RES_22_48K_EA;
.external _RES_23_48K_SA;
.external _RES_23_48K_EA;
.external _RES_24_48K_SA;
.external _RES_24_48K_EA;
.external _RES_25_48K_SA;
.external _RES_25_48K_EA;
.external _RES_26_48K_SA;
.external _RES_26_48K_EA;
.external _RES_8_48K_SA;
.external _RES_8_48K_EA;
.external _RES_3_48K_SA;
.external _RES_3_48K_EA;
.external _RES_4_48K_SA;
.external _RES_4_48K_EA;
.external _RES_5_48K_SA;
.external _RES_5_48K_EA;
.external _RES_6_48K_SA;
.external _RES_6_48K_EA;
.external _RES_7_48K_SA;
.external _RES_7_48K_EA;
.external _RES_0_48K_SA;
.external _RES_0_48K_EA;
.external _RES_27_48K_SA;
.external _RES_27_48K_EA;

// End Table
