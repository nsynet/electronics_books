.EXTERNAL 	Set_IOA_Bit;
.EXTERNAL 	Set_IOB_Bit;
.EXTERNAL 	Get_IOA_Bit;
.EXTERNAL 	Get_IOB_Bit;
.EXTERNAL 	Set_IOA0_Dir0;
.EXTERNAL 	Set_IOA0_Dir1;
.EXTERNAL 	Set_IOA1_Dir0;
.EXTERNAL 	Set_IOA1_Dir1;
.EXTERNAL 	Set_IOA2_Dir0;
.EXTERNAL 	Set_IOA2_Dir1;
.EXTERNAL 	Set_IOA3_Dir0;
.EXTERNAL 	Set_IOA3_Dir1;
.EXTERNAL 	Set_IOA4_Dir0;
.EXTERNAL 	Set_IOA4_Dir1;
.EXTERNAL 	Set_IOA5_Dir0;
.EXTERNAL 	Set_IOA5_Dir1;
.EXTERNAL 	Set_IOA6_Dir0;
.EXTERNAL 	Set_IOA6_Dir1;
.EXTERNAL 	Set_IOA7_Dir0;
.EXTERNAL 	Set_IOA7_Dir1;
.EXTERNAL 	Set_IOA8_Dir0;
.EXTERNAL 	Set_IOA8_Dir1;
.EXTERNAL 	Set_IOA9_Dir0;
.EXTERNAL 	Set_IOA9_Dir1;
.EXTERNAL 	Set_IOA10_Dir0;
.EXTERNAL 	Set_IOA10_Dir1;
.EXTERNAL 	Set_IOA11_Dir0;
.EXTERNAL 	Set_IOA11_Dir1;
.EXTERNAL 	Set_IOA12_Dir0;
.EXTERNAL 	Set_IOA12_Dir1;
.EXTERNAL 	Set_IOA13_Dir0;
.EXTERNAL 	Set_IOA13_Dir1;
.EXTERNAL 	Set_IOA14_Dir0;
.EXTERNAL 	Set_IOA14_Dir1;
.EXTERNAL 	Set_IOA15_Dir0;
.EXTERNAL 	Set_IOA15_Dir1;
.EXTERNAL 	Set_IOB0_Dir0;
.EXTERNAL 	Set_IOB0_Dir1;
.EXTERNAL 	Set_IOB1_Dir0;
.EXTERNAL 	Set_IOB1_Dir1;
.EXTERNAL 	Set_IOB2_Dir0;
.EXTERNAL 	Set_IOB2_Dir1;
.EXTERNAL 	Set_IOB3_Dir0;
.EXTERNAL 	Set_IOB3_Dir1;
.EXTERNAL 	Set_IOB4_Dir0;
.EXTERNAL 	Set_IOB4_Dir1;
.EXTERNAL 	Set_IOB5_Dir0;
.EXTERNAL 	Set_IOB5_Dir1;
.EXTERNAL 	Set_IOB6_Dir0;
.EXTERNAL 	Set_IOB6_Dir1;
.EXTERNAL 	Set_IOB7_Dir0;
.EXTERNAL 	Set_IOB7_Dir1;
.EXTERNAL 	Set_IOB8_Dir0;
.EXTERNAL 	Set_IOB8_Dir1;
.EXTERNAL 	Set_IOB9_Dir0;
.EXTERNAL 	Set_IOB9_Dir1;
.EXTERNAL 	Set_IOB10_Dir0;
.EXTERNAL 	Set_IOB10_Dir1;
.EXTERNAL 	Set_IOB11_Dir0;
.EXTERNAL 	Set_IOB11_Dir1;
.EXTERNAL 	Set_IOB12_Dir0;
.EXTERNAL 	Set_IOB12_Dir1;
.EXTERNAL 	Set_IOB13_Dir0;
.EXTERNAL 	Set_IOB13_Dir1;
.EXTERNAL 	Set_IOB14_Dir0;
.EXTERNAL 	Set_IOB14_Dir1;
.EXTERNAL 	Set_IOB15_Dir0;
.EXTERNAL 	Set_IOB15_Dir1;
.EXTERNAL 	Set_IOA0_Attrib0;
.EXTERNAL 	Set_IOA0_Attrib1;
.EXTERNAL 	Set_IOA1_Attrib0;
.EXTERNAL 	Set_IOA1_Attrib1;
.EXTERNAL 	Set_IOA2_Attrib0;
.EXTERNAL 	Set_IOA2_Attrib1;
.EXTERNAL 	Set_IOA3_Attrib0;
.EXTERNAL 	Set_IOA3_Attrib1;
.EXTERNAL 	Set_IOA4_Attrib0;
.EXTERNAL 	Set_IOA4_Attrib1;
.EXTERNAL 	Set_IOA5_Attrib0;
.EXTERNAL 	Set_IOA5_Attrib1;
.EXTERNAL 	Set_IOA6_Attrib0;
.EXTERNAL 	Set_IOA6_Attrib1;
.EXTERNAL 	Set_IOA7_Attrib0;
.EXTERNAL 	Set_IOA7_Attrib1;
.EXTERNAL 	Set_IOA8_Attrib0;
.EXTERNAL 	Set_IOA8_Attrib1;
.EXTERNAL 	Set_IOA9_Attrib0;
.EXTERNAL 	Set_IOA9_Attrib1;
.EXTERNAL 	Set_IOA10_Attrib0;
.EXTERNAL 	Set_IOA10_Attrib1;
.EXTERNAL 	Set_IOA11_Attrib0;
.EXTERNAL 	Set_IOA11_Attrib1;
.EXTERNAL 	Set_IOA12_Attrib0;
.EXTERNAL 	Set_IOA12_Attrib1;
.EXTERNAL 	Set_IOA13_Attrib0;
.EXTERNAL 	Set_IOA13_Attrib1;
.EXTERNAL 	Set_IOA14_Attrib0;
.EXTERNAL 	Set_IOA14_Attrib1;
.EXTERNAL 	Set_IOA15_Attrib0;
.EXTERNAL 	Set_IOA15_Attrib1;
.EXTERNAL 	Set_IOB0_Attrib0;
.EXTERNAL 	Set_IOB0_Attrib1;
.EXTERNAL 	Set_IOB1_Attrib0;
.EXTERNAL 	Set_IOB1_Attrib1;
.EXTERNAL 	Set_IOB2_Attrib0;
.EXTERNAL 	Set_IOB2_Attrib1;
.EXTERNAL 	Set_IOB3_Attrib0;
.EXTERNAL 	Set_IOB3_Attrib1;
.EXTERNAL 	Set_IOB4_Attrib0;
.EXTERNAL 	Set_IOB4_Attrib1;
.EXTERNAL 	Set_IOB5_Attrib0;
.EXTERNAL 	Set_IOB5_Attrib1;
.EXTERNAL 	Set_IOB6_Attrib0;
.EXTERNAL 	Set_IOB6_Attrib1;
.EXTERNAL 	Set_IOB7_Attrib0;
.EXTERNAL 	Set_IOB7_Attrib1;
.EXTERNAL 	Set_IOB8_Attrib0;
.EXTERNAL 	Set_IOB8_Attrib1;
.EXTERNAL 	Set_IOB9_Attrib0;
.EXTERNAL 	Set_IOB9_Attrib1;
.EXTERNAL 	Set_IOB10_Attrib0;
.EXTERNAL 	Set_IOB10_Attrib1;
.EXTERNAL 	Set_IOB11_Attrib0;
.EXTERNAL 	Set_IOB11_Attrib1;
.EXTERNAL 	Set_IOB12_Attrib0;
.EXTERNAL 	Set_IOB12_Attrib1;
.EXTERNAL 	Set_IOB13_Attrib0;
.EXTERNAL 	Set_IOB13_Attrib1;
.EXTERNAL 	Set_IOB14_Attrib0;
.EXTERNAL 	Set_IOB14_Attrib1;
.EXTERNAL 	Set_IOB15_Attrib0;
.EXTERNAL 	Set_IOB15_Attrib1;
.EXTERNAL 	Set_IOA0_Buffer0;
.EXTERNAL 	Set_IOA0_Buffer1;
.EXTERNAL 	Set_IOA1_Buffer0;
.EXTERNAL 	Set_IOA1_Buffer1;
.EXTERNAL 	Set_IOA2_Buffer0;
.EXTERNAL 	Set_IOA2_Buffer1;
.EXTERNAL 	Set_IOA3_Buffer0;
.EXTERNAL 	Set_IOA3_Buffer1;
.EXTERNAL 	Set_IOA4_Buffer0;
.EXTERNAL 	Set_IOA4_Buffer1;
.EXTERNAL 	Set_IOA5_Buffer0;
.EXTERNAL 	Set_IOA5_Buffer1;
.EXTERNAL 	Set_IOA6_Buffer0;
.EXTERNAL 	Set_IOA6_Buffer1;
.EXTERNAL 	Set_IOA7_Buffer0;
.EXTERNAL 	Set_IOA7_Buffer1;
.EXTERNAL 	Set_IOA8_Buffer0;
.EXTERNAL 	Set_IOA8_Buffer1;
.EXTERNAL 	Set_IOA9_Buffer0;
.EXTERNAL 	Set_IOA9_Buffer1;
.EXTERNAL 	Set_IOA10_Buffer0;
.EXTERNAL 	Set_IOA10_Buffer1;
.EXTERNAL 	Set_IOA11_Buffer0;
.EXTERNAL 	Set_IOA11_Buffer1;
.EXTERNAL 	Set_IOA12_Buffer0;
.EXTERNAL 	Set_IOA12_Buffer1;
.EXTERNAL 	Set_IOA13_Buffer0;
.EXTERNAL 	Set_IOA13_Buffer1;
.EXTERNAL 	Set_IOA14_Buffer0;
.EXTERNAL 	Set_IOA14_Buffer1;
.EXTERNAL 	Set_IOA15_Buffer0;
.EXTERNAL 	Set_IOA15_Buffer1;
.EXTERNAL 	Set_IOB0_Buffer0;
.EXTERNAL 	Set_IOB0_Buffer1;
.EXTERNAL 	Set_IOB1_Buffer0;
.EXTERNAL 	Set_IOB1_Buffer1;
.EXTERNAL 	Set_IOB2_Buffer0;
.EXTERNAL 	Set_IOB2_Buffer1;
.EXTERNAL 	Set_IOB3_Buffer0;
.EXTERNAL 	Set_IOB3_Buffer1;
.EXTERNAL 	Set_IOB4_Buffer0;
.EXTERNAL 	Set_IOB4_Buffer1;
.EXTERNAL 	Set_IOB5_Buffer0;
.EXTERNAL 	Set_IOB5_Buffer1;
.EXTERNAL 	Set_IOB6_Buffer0;
.EXTERNAL 	Set_IOB6_Buffer1;
.EXTERNAL 	Set_IOB7_Buffer0;
.EXTERNAL 	Set_IOB7_Buffer1;
.EXTERNAL 	Set_IOB8_Buffer0;
.EXTERNAL 	Set_IOB8_Buffer1;
.EXTERNAL 	Set_IOB9_Buffer0;
.EXTERNAL 	Set_IOB9_Buffer1;
.EXTERNAL 	Set_IOB10_Buffer0;
.EXTERNAL 	Set_IOB10_Buffer1;
.EXTERNAL 	Set_IOB11_Buffer0;
.EXTERNAL 	Set_IOB11_Buffer1;
.EXTERNAL 	Set_IOB12_Buffer0;
.EXTERNAL 	Set_IOB12_Buffer1;
.EXTERNAL 	Set_IOB13_Buffer0;
.EXTERNAL 	Set_IOB13_Buffer1;
.EXTERNAL 	Set_IOB14_Buffer0;
.EXTERNAL 	Set_IOB14_Buffer1;
.EXTERNAL 	Set_IOB15_Buffer0;
.EXTERNAL 	Set_IOB15_Buffer1;
.EXTERNAL 	Set_IOA0_Data0;
.EXTERNAL 	Set_IOA0_Data1;
.EXTERNAL 	Set_IOA1_Data0;
.EXTERNAL 	Set_IOA1_Data1;
.EXTERNAL 	Set_IOA2_Data0;
.EXTERNAL 	Set_IOA2_Data1;
.EXTERNAL 	Set_IOA3_Data0;
.EXTERNAL 	Set_IOA3_Data1;
.EXTERNAL 	Set_IOA4_Data0;
.EXTERNAL 	Set_IOA4_Data1;
.EXTERNAL 	Set_IOA5_Data0;
.EXTERNAL 	Set_IOA5_Data1;
.EXTERNAL 	Set_IOA6_Data0;
.EXTERNAL 	Set_IOA6_Data1;
.EXTERNAL 	Set_IOA7_Data0;
.EXTERNAL 	Set_IOA7_Data1;
.EXTERNAL 	Set_IOA8_Data0;
.EXTERNAL 	Set_IOA8_Data1;
.EXTERNAL 	Set_IOA9_Data0;
.EXTERNAL 	Set_IOA9_Data1;
.EXTERNAL 	Set_IOA10_Data0;
.EXTERNAL 	Set_IOA10_Data1;
.EXTERNAL 	Set_IOA11_Data0;
.EXTERNAL 	Set_IOA11_Data1;
.EXTERNAL 	Set_IOA12_Data0;
.EXTERNAL 	Set_IOA12_Data1;
.EXTERNAL 	Set_IOA13_Data0;
.EXTERNAL 	Set_IOA13_Data1;
.EXTERNAL 	Set_IOA14_Data0;
.EXTERNAL 	Set_IOA14_Data1;
.EXTERNAL 	Set_IOA15_Data0;
.EXTERNAL 	Set_IOA15_Data1;
.EXTERNAL 	Set_IOB0_Data0;
.EXTERNAL 	Set_IOB0_Data1;
.EXTERNAL 	Set_IOB1_Data0;
.EXTERNAL 	Set_IOB1_Data1;
.EXTERNAL 	Set_IOB2_Data0;
.EXTERNAL 	Set_IOB2_Data1;
.EXTERNAL 	Set_IOB3_Data0;
.EXTERNAL 	Set_IOB3_Data1;
.EXTERNAL 	Set_IOB4_Data0;
.EXTERNAL 	Set_IOB4_Data1;
.EXTERNAL 	Set_IOB5_Data0;
.EXTERNAL 	Set_IOB5_Data1;
.EXTERNAL 	Set_IOB6_Data0;
.EXTERNAL 	Set_IOB6_Data1;
.EXTERNAL 	Set_IOB7_Data0;
.EXTERNAL 	Set_IOB7_Data1;
.EXTERNAL 	Set_IOB8_Data0;
.EXTERNAL 	Set_IOB8_Data1;
.EXTERNAL 	Set_IOB9_Data0;
.EXTERNAL 	Set_IOB9_Data1;
.EXTERNAL 	Set_IOB10_Data0;
.EXTERNAL 	Set_IOB10_Data1;
.EXTERNAL 	Set_IOB11_Data0;
.EXTERNAL 	Set_IOB11_Data1;
.EXTERNAL 	Set_IOB12_Data0;
.EXTERNAL 	Set_IOB12_Data1;
.EXTERNAL 	Set_IOB13_Data0;
.EXTERNAL 	Set_IOB13_Data1;
.EXTERNAL 	Set_IOB14_Data0;
.EXTERNAL 	Set_IOB14_Data1;
.EXTERNAL 	Set_IOB15_Data0;
.EXTERNAL 	Set_IOB15_Data1;
.EXTERNAL  	Get_Data_IOA0;
.EXTERNAL 	Get_Data_IOB0;
.EXTERNAL 	Get_Data_IOA1;
.EXTERNAL 	Get_Data_IOB1;
.EXTERNAL 	Get_Data_IOA2;
.EXTERNAL 	Get_Data_IOB2;
.EXTERNAL 	Get_Data_IOA3;
.EXTERNAL 	Get_Data_IOA3;
.EXTERNAL 	Get_Data_IOB4;
.EXTERNAL 	Get_Data_IOA4;
.EXTERNAL 	Get_Data_IOB5;
.EXTERNAL 	Get_Data_IOA5;
.EXTERNAL 	Get_Data_IOB6;
.EXTERNAL 	Get_Data_IOA6;
.EXTERNAL 	Get_Data_IOA7;
.EXTERNAL 	Get_Data_IOB7;
.EXTERNAL 	Get_Data_IOA8;
.EXTERNAL 	Get_Data_IOB8;
.EXTERNAL 	Get_Data_IOA9;
.EXTERNAL 	Get_Data_IOB9;
.EXTERNAL 	Get_Data_IOA10;
.EXTERNAL 	Get_Data_IOB10;
.EXTERNAL 	Get_Data_IOA11;
.EXTERNAL 	Get_Data_IOB11;
.EXTERNAL 	Get_Data_IOB12;
.EXTERNAL 	Get_Data_IOB12;
.EXTERNAL 	Get_Data_IOA13;
.EXTERNAL 	Get_Data_IOB13;
.EXTERNAL 	Get_Data_IOA14;
.EXTERNAL 	Get_Data_IOB14;
.EXTERNAL 	Get_Data_IOA15;
.EXTERNAL 	Get_Data_IOB15;
.EXTERNAL  	Get_Buffer_IOA0;
.EXTERNAL 	Get_Buffer_IOB0;
.EXTERNAL 	Get_Buffer_IOA1;
.EXTERNAL 	Get_Buffer_IOB1;
.EXTERNAL 	Get_Buffer_IOA2;
.EXTERNAL 	Get_Buffer_IOB2;
.EXTERNAL 	Get_Buffer_IOA3;
.EXTERNAL 	Get_Buffer_IOA3;
.EXTERNAL 	Get_Buffer_IOB4;
.EXTERNAL 	Get_Buffer_IOA4;
.EXTERNAL 	Get_Buffer_IOB5;
.EXTERNAL 	Get_Buffer_IOA5;
.EXTERNAL 	Get_Buffer_IOB6;
.EXTERNAL 	Get_Buffer_IOA6;
.EXTERNAL 	Get_Buffer_IOA7;
.EXTERNAL 	Get_Buffer_IOB7;
.EXTERNAL 	Get_Buffer_IOA8;
.EXTERNAL 	Get_Buffer_IOB8;
.EXTERNAL 	Get_Buffer_IOA9;
.EXTERNAL 	Get_Buffer_IOB9;
.EXTERNAL 	Get_Buffer_IOA10;
.EXTERNAL 	Get_Buffer_IOB10;
.EXTERNAL 	Get_Buffer_IOA11;
.EXTERNAL 	Get_Buffer_IOB11;
.EXTERNAL 	Get_Buffer_IOB12;
.EXTERNAL 	Get_Buffer_IOB12;
.EXTERNAL 	Get_Buffer_IOA13;
.EXTERNAL 	Get_Buffer_IOB13;
.EXTERNAL 	Get_Buffer_IOA14;
.EXTERNAL 	Get_Buffer_IOB14;
.EXTERNAL 	Get_Buffer_IOA15;
.EXTERNAL 	Get_Buffer_IOB15;