#ifndef	__RESOURCE_H__
#define	__RESOURCE_H__
//	write your header here
#endif

// Resource Table
// Created by IDE, Do not modify this table

.TEXT
.external _RES_Table;
.external _RES_WISH1_BIN_SA;
.external _RES_WISH1_BIN_EA;
.external _RES_ALA1_BIN_SA;
.external _RES_ALA1_BIN_EA;
.external _RES_ALAINS_BIN_SA;
.external _RES_ALAINS_BIN_EA;
.external _RES_DECK1_BIN_SA;
.external _RES_DECK1_BIN_EA;
.external _RES_GREEN1_BIN_SA;
.external _RES_GREEN1_BIN_EA;
.external _RES_HK1_BIN_SA;
.external _RES_HK1_BIN_EA;
.external _RES_LA1_BIN_SA;
.external _RES_LA1_BIN_EA;
.external _RES_PP1_BIN_SA;
.external _RES_PP1_BIN_EA;
.external _RES_S31_BIN_SA;
.external _RES_S31_BIN_EA;
.external _RES_TW1_BIN_SA;
.external _RES_TW1_BIN_EA;
.external _RES_WINE1_BIN_SA;
.external _RES_WINE1_BIN_EA;
.external _RES_1231_BIN_SA;
.external _RES_1231_BIN_EA;

// End Table
