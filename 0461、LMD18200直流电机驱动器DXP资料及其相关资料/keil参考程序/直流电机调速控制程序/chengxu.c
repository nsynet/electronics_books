
////////////////////////汇诚科技////////////////////
//////////////////http://www.ourhc.cn///////////////
///////////////////直流电机调速控制程序/////////////////
#include <reg52.h>             //头文件
#define uchar unsigned char	   //宏定义无符号字符型
#define uint  unsigned  int	   //宏定义无符号整型

uchar b;		//中断值
uchar N=0;		//占空比计数值
uchar X=10;		//占空比初始值

uchar key_up;
uchar key_down;

/********************************************************
 						控制位定义
********************************************************/
sbit qi_dong=P2^0;//M1启动
sbit ting_zhi=P2^1;//M1停止
sbit jia_su=P2^2; //M1加速
sbit jian_su=P2^3;//M1减速

sbit fang_xiang=P1^0;  //	方向控制位	（输入1正转，输入0反转）
sbit sha_che=P1^1;     //	启停控制位
sbit PWM=P1^2;         //	速度控制位 （输入电平为1时，电机全速运行，当输入PWM信号时可

/*************************************************************************/
void get_key(void)//按键扫描函数

{
while(jia_su==0)//按键加计数标志
{key_up=1;
}
while(jian_su==0)//按键减计数标志
{key_down=1;
}
}
 /*************************************************************************/
void timer0( ) interrupt 1 //定时器0工作方式1
{

TH0=(65536-1)/256;	  //重装计数初值
TL0=(65536-1)%256;	  //重装计数初值
b++;
get_key();
 if (key_up==1)
       {
           if(X!=100)//判断是否计数到9999
              {
               X=X+5;//加一
               key_up=0;
			   }
        }
if (key_down==1)
       {
            if(X!=0)//判断是否计数到0
              {
        	   X=X-5;//减一
               key_down=0;
               }
        }
 if(qi_dong==0) {sha_che=0;}   //	启动
 if(ting_zhi==0){sha_che=1;}   //	刹车
}

 /*************************************************************************/
void main()
{ 
TMOD=0X01;			  //定时器中断0
TH0=(65536-2)/256;	  //定时时间高八位初值
TL0=(65536-2)%256;	  //定时时间低八位初值
EA=1;				  //开CPU中断
ET0=1;				  //开T/C0中断
TR0=1;
 fang_xiang=1;
 sha_che=0;
 while(1)			   //无限循环
	{
 PWM=1;		   //输出PWM正
 while(1)
 {
 b=0;
 while(!b);
 if (N==X)
 PWM=0;
 if (N==100)break;
 N++;

	  }
            N=0;   
	  }	 
}				