/********************************************************************
                            汇诚科技
网址：http://www.ourhc.cn
产品有售淘宝店：http://shop36330473.taobao.com   
*********************************************************************/
/**********************************************************************
				   流水灯  					   	
**********************************************************************/

#include<pic.h>  //头文件
//__CONFIG(0x3B31);//MPLAB和PICC的连接语
/**********************************************************************
				  函数数据类型说明							   	
**********************************************************************/
#define uchar unsigned char 
#define uint unsigned int
/**********************************************************************
				  MS级延时函数程序，参数i 延时时间								   	
**********************************************************************/
void DelayMS(uint i)
{
uint j;
for(;i!=0;i--)
{
for(j=8000;j!=0;j--);
}
}
/*********************************************************************
				   主函数						   	
**********************************************************************/
void main()     //主函数
{
	uchar k;
	TRISD=0x00;
	while(1)
	{
		PORTD=0x01;
		for(k=8;k>0;k--)
		{
			DelayMS(5);
			PORTD=PORTD<<1;
		}
	}
}
/**********************************************************************
				                 结束					   	
**********************************************************************/
