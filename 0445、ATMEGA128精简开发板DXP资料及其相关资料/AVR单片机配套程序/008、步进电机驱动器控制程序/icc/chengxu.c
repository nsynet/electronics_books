#include<iom128v.h>
#include <macros.h>
/**********************************************************************
				  函数数据类型说明							   	
**********************************************************************/
#define uint unsigned int
#define uchar unsigned char

/**********************************************************************
				初始化I/0口							   	
**********************************************************************/
void int_io()
{
   DDRD  =0xff;  
}

/**********************************************************************
				  MS级延时函数程序，参数Timer 延时时间								   	
**********************************************************************/
void Delay_us(int Timer)
{
   int i,j;
   for( i = Timer; i > 0; i--)
   for( j = 11   ; j > 0; j--)
   NOP();
}

/**********************************************************************
				   主函数						   	
**********************************************************************/
void main()
{
    int_io();
   PORTD|=(1<<4);//控制使能
   PORTD|=(1<<5);//控制工作方式
   PORTD&=~(1<<6);//控制正反转
   while(1)//脉冲输出控制速度
   {      
         Delay_us(10000);
         PORTD&=~(1<<7);
         Delay_us(10000);
         PORTD|=(1<<7);
        
   }
}
/**********************************************************************
				                 结束					   	
**********************************************************************/