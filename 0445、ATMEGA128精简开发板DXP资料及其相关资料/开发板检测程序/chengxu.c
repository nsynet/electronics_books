#include <iom128.h>
/**********************************************************************
				  函数数据类型说明							   	
**********************************************************************/
#define uchar unsigned char 
#define uint unsigned int
/**********************************************************************
				  MS级延时函数程序，参数i 延时时间								   	
**********************************************************************/
void DelayMS(uint i)
{
uint j;
for(;i!=0;i--)
{
for(j=8000;j!=0;j--);
}
}
/**********************************************************************
				   主函数						   	
**********************************************************************/
void main(void)
{
 //DDRD=0XFF;//端口设置，PD口设置为推挽1输出
 //PORTD=0XFF;
 DDRA=0XFF;//端口设置，PA口设置为推挽1输出
 PORTA=0XFF;
 DDRB=0XFF;//端口设置，PB口设置为推挽1输出
 PORTB=0XFF;
 DDRC=0XFF;//端口设置，PC口设置为推挽1输出
 PORTC=0XFF;
 DDRD=0XFF;//端口设置，PD口设置为推挽1输出
 PORTD=0XFF;
 DDRE=0XFF;//端口设置，PE口设置为推挽1输出
 PORTE=0XFF;
 DDRF=0XFF;//端口设置，PF口设置为推挽1输出
 PORTF=0XFF;
 DDRG=0XFF;//端口设置，PG口设置为推挽1输出
 PORTG=0XFF;
 			while(1)//程序无条件执行
			{
			    //PORTD=0X00;
				PORTA=0X00;
				PORTB=0X00;
				PORTC=0X00;
				PORTD=0X00;
				PORTE=0X00;
				PORTF=0X00;
				PORTG=0X00;
			 	DelayMS(100);//延时时间约100MS
				//PORTD=0XFF;
				PORTA=0XFF;
				PORTB=0XFF;
				PORTC=0XFF;
				PORTD=0XFF;
				PORTE=0XFF;
				PORTF=0XFF;
				PORTG=0XFF;
			 	DelayMS(100);//延时时间约100MS
			}
}
/**********************************************************************
				                 结束					   	
**********************************************************************/