
////////////////////////汇诚科技////////////////////
//////////////////http://www.ourhc.cn///////////////
///////////////////步进电机正转调试程序/////////////

#include<reg52.h> 
#define uchar unsigned char
#define uint unsigned int

/********************************************************
 						控制位定义
********************************************************/

sbit shi_neng=P2^0;  //	使能控制位
sbit fang_shi=P2^1;  //	工作方式控制位
sbit fang_xiang=P2^2;//	旋转方向控制位
sbit mai_chong=P2^3; // 脉冲控制位

/********************************************************
 						延时函数
********************************************************/
void delay(uint i)//延时函数
{
	uchar j,k;
	for(j=0;j<i;j++)
	for(k=0;k<250;k++);
}

/********************************************************
 						延时函数
********************************************************/

main()
{
	shi_neng=1;  //	使能控制位
	fang_shi=1;  //	工作方式控制位
	fang_xiang=1;//	旋转方向控制位
	mai_chong=1; // 脉冲控制位
	
	while(1)
	{
		mai_chong=~mai_chong; //输出时钟脉冲
		delay(8);			  //延时  (括号内数值越小，电机转动速度越快)
		
	}
}