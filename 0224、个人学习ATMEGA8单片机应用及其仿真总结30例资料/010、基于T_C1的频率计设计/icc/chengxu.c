#include <iom16v.h>
#include <macros.h>       
/********************************************************************
                数据类型定义
*********************************************************************/   
#define uchar unsigned char
#define uint  unsigned int

#define CON 1000      
//频率常数定义
uchar Flag=0;         
//捕获次数定义

/********************************************************************
                数码管段码定义0123456789
*********************************************************************/
uchar Table[10]={0x3f,0x06,0x5b,0x4f,0x66,0x6d,0x7d,0x07,
                 0x7f,0x6f};
uchar Data[4]={0,0,0,0};       //显示初始值：0 0 0 0
uint  CNT1;                    //第一次捕获值
uint  CNT2;                    //第二此捕获值
uint  CNT=100;                 //捕获差值 
/**********************************************************************
				  MS级延时函数程序，参数i 延时时间					   	
**********************************************************************/      
void DelayMs(uint i)           //Ms级延时，参数i为延时时间
{uint j;
 for(;i!=0;i--)
  {for(j=8000;j!=0;j--) {;}}
}
/**********************************************************************
				            显示函数		
注意：使用开发板时sel=0xef;
**********************************************************************/
void Display(uchar *p)         //动态显示函数，参数p为待显示的数组名
{uchar i,sel=0x01;           
 for(i=0;i<4;i++)
  {PORTC=sel;                  //选通最右边的数码管
   PORTA=~Table[p[i]];          //送字型码
   DelayMs(1);                 //显示延时    
   sel=sel<<1;                 //移位以显示前一位
  }
}
/**************************频率值处理函数********************************/
void HZ(uint i,uchar *p)
{
 uint TEM;
 p[0]=CON/i;
 TEM=CON%i;
 TEM=TEM*10;
 p[1]=TEM/i;
 TEM=TEM%i;
 TEM=TEM*10;
 p[2]=TEM/i;
 TEM=TEM%i;
 TEM=TEM*10;
 p[3]=TEM/i;
}
/**********************************************************************
				           初始化I/O			   	
**********************************************************************/
void Init_IO(void)             //初始化I/O口
{DDRA=0xff;                    //设置A口为推挽1输出
 PORTA=0xff;
 DDRC=0xff;                    //设置C口为推挽1输出             
 PORTC=0xff;
 DDRD=0x00;                    //设置D口为带上拉电阻输入
 PORTD=0x00;    
}
/**********************************************************************
				          初始化T/C1的输入捕获中断		   	
**********************************************************************/
void Init_Timer1(void)         //初始化T/C1的输入捕获中断
{
 TIMSK=TIMSK|0x20;             //输入捕获使能
 TCCR1B=0xC2;                  //输入捕获噪音使能，下降沿捕获，时钟8分频1uS计数一次。
 ICR1H=0x00;
 ICR1L=0x00;
 TIFR=0x20;                    //清中断标志
 SREG=SREG&0x7f;               //全局中断关
 } 
/**********************************************************************
				          主函数		   	
**********************************************************************/
void main(void)
{uchar i;
 Init_IO();                    //初始化I/O口
 Init_Timer1();                //T/C1初试化 
 while(1)
  {
while(TIFR&0x20)             //捕获检测
      {
	  TIFR|=0x20;             //清除捕获标志
	  CNT1=ICR1L;
	  CNT2=(ICR1H<<8)+ICR1L; 
	  CNT=CNT2;
	  Flag++;
	   }                //检测到第一次捕获
   if(Flag==1)                 //检测到第二此捕获
      {Flag=0;                 //清除捕获检测标志
	   HZ(CNT,Data);           //数据处理
	   for(i=0;i<100;i++)      //频率显示
	       Display(Data);
	   CNT=0;CNT1=0;CNT2=0;
	   ICR1H=0x00;
       ICR1L=0x00;
	   }
	   }  //清除捕获值及捕获差值
}
/**********************************************************************
				                  结束		   	
**********************************************************************/