#include <iom8v.h>
//#include <macros.h> 
/********************************************************************
                数据类型定义
*********************************************************************/
#define uchar unsigned char
/*宏定义字符类型*/
#define uint  unsigned int
/*宏定义整类型*/
#define WEI PORTC
/*宏定义位码为PC口*/
#define DUAN PORTB
/*宏定义段码为PB口*/

uchar key_up;//按键标志
/********************************************************************
                数码管段码定义0123456789
*********************************************************************/
uchar Table[10]={0x3f,0x06,0x5b,0x4f,0x66,0x6d,0x7d,0x07,0x7f,0x6f};//数码管段码编码
uchar Data[6]={0,0,0,0,0,0};    //显示初始值：0 0 0 0 0 0
uchar y=0;                      //个位十位计数值：0 
uchar j=0;						//百位千位计数值：0
uchar k=0;						//万位十万位计数值：0

/**********************************************************************
				  MS级延时函数程序，参数i 延时时间					   	
**********************************************************************/
void DelayMs(uint i)           //Ms级延时，参数i为延时时间
{uint j;
 for(;i!=0;i--)
  {for(j=8000;j!=0;j--) {;}}
}
/**********************************************************************
				            显示函数		

**********************************************************************/
void Display(uchar *p)         //动态显示函数，参数p为待显示的数组名
{
 uchar i,sel=0x01;             //移位初始值
 for(i=0;i<6;i++)
  {
   WEI=sel;                    //选通最右边的数码管
   DUAN=~Table[p[i]];          //送字型码
   DelayMs(1);                 //延时    
   sel=sel<<1;                 //移位以显示前一位
  }
}

//计数值处理函数。参数i:计数值；参数p:处理数据存放的数组名//
//功能：此函数用于将计数值拆分为BCD码的十万，万，千，百，十，一数据，用于查表显示//
void Process(uchar i,uchar *p) 
{
 i=TCNT0;
 if(i>=100){j++;TCNT0=0;}//如果i值大于等于100,j值加1，计数寄存器赋初值。
 y=i;
 p[5]=i%10;
 p[4]=i/10;
 if(j>=100){k++;j=0;}	   //如果j值大于等于100,k值加1，j值赋初值。											  
 p[3]=j%10;
 p[2]=j/10;
 if(k>=100){k=0;}	       //如果j值大于等于100,k值加1，j值赋初值。		
 p[1]=k%10;
 p[0]=k/10;
}

/**********************************************************************
				           初始化I/O			   	
**********************************************************************/
void Init_IO(void)             //初始化I/O口
{
 DDRB=0xff;                    //设置B口为推挽1输出
 DUAN=0xff;
 DDRD=0x00;                    //设置D口为不带上拉电阻输入
 PORTD=0x00;    
 DDRC=0xff;                    //设置C口为推挽1输出；             
 WEI=0xff;
}
/**********************************************************************
				          按键扫描函数		   	
**********************************************************************/

void get_key(void)//按键扫描函数
{
if((PIND&0X20)==0){key_up=1;}//确定清零按键按下
//if((PIND&0X40)==0){key_down=1;}
}
/**********************************************************************
		  写一字节到EEPROM数据	
		参数：Date：写入的数据；  
		    Address:写入的地址					   	
**********************************************************************/
void Write_EEPROM(uchar Data,uint Address)
{if(EECR&0x20) DelayMs(4);//判断写使能是否为0
 EEARH=Address>>8;        //送高地址
 EEARL=Address&0x00ff;    //送低地址
 EEDR=Data;               //送数据
 EECR=EECR|0x04;          //主写使能置位
 EECR=EECR|0x02;          //写使能置位
 DelayMs(4);              //延时（写入时间约在2.5ms~4ms）
}
/**********************************************************************
			读一字节到EEPROM数据	
		参数:Address：写入的地址；返回值：读取的内容							   	
**********************************************************************/
uchar Read_EEPROM(uint Address)
{uchar i;
 if(EECR&0x01) DelayMs(4);//判断读使能是否为0
 EEARH=Address>>8;        //送高地址
 EEARL=Address&0x00ff;    //送低地址
 EECR=EECR|0x01;          //读使能置位
 DelayMs(5);              //延时
 i=EEDR;                  //读数据
 return(i);
}
/**********************************************************************
				          主函数		   	
**********************************************************************/
void main(void)
{
 uchar Load;   				   //定义字符变量Load									   
 Init_IO();                    //初始化I/O口
 DUAN=0xff;                    //点亮以测试所有的数码管控制段
 WEI=0x00;                     //点亮以测试所有的数码管控制位
 DelayMs(30);                  //延时
 PORTC=0xff;                   //熄灭所有的数码管
 TCCR0=0x06;                   //T/C0工作于计数方式，下降沿计数
 y=Read_EEPROM(1);//读出个位十位数据
 j=Read_EEPROM(2);//读出百位千位数据
 k=Read_EEPROM(3);//读出万位十万位数据
 TCNT0=y;                    //计数初始赋值
 while(1)					 //执行无限循环
 {
  if(key_up==1){TCNT0=0;j=0;k=0;key_up=0;}
  Process(y,Data);          //计数值处理
  Display(Data);            //动态扫描显示
  get_key();				//读取键值函数
  Write_EEPROM(y,1);//写入个位十位
  Write_EEPROM(j,2);//写入百位千位
  Write_EEPROM(k,3);//写入万位十万位
  }
  }
/**********************************************************************
				                  结束		   	
**********************************************************************/