#include <iom16v.h>
/********************************************************************
                数据类型定义
*********************************************************************/
#define uchar unsigned char
#define uint  unsigned int
/********************************************************************
                数码管段码定义0123456789
*********************************************************************/
//数码管字型表，对应0，1，2，3，4，5，6，7，8，9//
uchar Table[10]={0x3f,0x06,0x5b,0x4f,0x66,0x6d,0x7d,0x07,0x7f,0x6f};
uchar Data[4]={0,0,0,0};       //定义初始时间：00：00            
uchar CNT=0;                     //定义中断计数次数    
/**********************************************************************
				  MS级延时函数程序，参数i 延时时间					   	
**********************************************************************/            
void DelayMs(uint i)           //Ms级延时，参数i为延时时间
{uint j;
 for(;i!=0;i--)
  {for(j=8000;j!=0;j--) {;}}
}
/**********************************************************************
				            显示函数		
注意：使用开发板时sel=0xef;
**********************************************************************/
void Display(uchar *p)         //动态显示函数，参数p为待显示的数组名
{uchar i,sel=0x01;           
 for(i=0;i<4;i++)
  {PORTC=sel;                  //选通最右边的数码管
   PORTA=~Table[p[i]];          //送字型码
   DelayMs(1);                 //显示延时    
   sel=sel<<1;                 //移位以显示前一位
  }
}
/**********************************************************************
				         初始化I/O口	
**********************************************************************/
void Init_IO(void)             //初始化I/O口
{DDRA=0xff;                    //设置A口为推挽1输出
 PORTA=0xff;
 DDRC=0xff;                    //设置C口为推挽1输出             
 PORTC=0xff;
}
/**********************************************************************
				         时间处理，最大计时59分59秒	
**********************************************************************/
void Add_Second(uchar *p)
{p[3]++;
 if(p[3]==10) {p[3]=0;p[2]++;}
 if(p[2]==6)  {p[2]=0;p[1]++;}
 if(p[1]==10) {p[1]=0;p[0]++;}
 if(p[0]==6)  {p[0]=0;}
}
/**********************************************************************
				          主函数		
**********************************************************************/
void main(void)
{uchar i;
 Init_IO();                    //初始化I/O口
 //TCCR2=0x00;				   //停止定时器
 //TIMSK=0X00;				   //关闭溢出中断使能
 ASSR=0x08;                    //异步时钟使能
 TCCR2=0x07;                   //32768的晶振1024分频作为T/C2的时钟源
 TCNT2=0Xff;				   //数据寄存器初始值（加1溢出）
 TIMSK=0x40;                   //T/C2溢出中断使能
 SREG=SREG|0x80;               //全局中断使能       
 while(1)
 {Display(Data);
 if(CNT==32) 
    {CNT=0;
	 Add_Second(Data);}		   //时间处理
 }
}
/******************TC2中断服务函数*******************************/
#pragma interrupt_handler Timer2:5
void Timer2(void)
{
TCNT2=0XFF;//数据寄存器初始值（加1溢出）
CNT=CNT+1;}//中断次数
/**********************************************************************
				                 结束		
**********************************************************************/