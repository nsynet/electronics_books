/********************************************************************
                            汇诚科技
网址：http://www.ourhc.cn
产品有售淘宝店：http://shop36330473.taobao.com   
*********************************************************************/
#include <iom8v.h>
/**********************************************************************
				  函数数据类型说明							   	
**********************************************************************/
#define uchar unsigned char 
#define uint unsigned int
/**********************************************************************
				  MS级延时函数程序，参数i 延时时间								   	
**********************************************************************/
void DelayMS(uint i)
{
uint j;
for(;i!=0;i--)
{
for(j=8000;j!=0;j--);
}
}
/**********************************************************************
				  跑马灯程序，通过跑过的步数进行判断来点亮相应的LED
				  低电平点亮LED								   	
**********************************************************************/
void horse(uchar i)
{switch (i)
{
case 0:PORTB=0X00;break;//0000 0000B 点亮LED1~LED8
case 1:PORTB=0X01;break;//0000 0001B 点亮LED2~LED8
case 2:PORTB=0X03;break;//0000 0011B 点亮LED3~LED8
case 3:PORTB=0X07;break;//0000 0111B 点亮LED4~LED8
case 4:PORTB=0X0f;break;//0000 1111B 点亮LED5~LED8
case 5:PORTB=0X1f;break;//0001 1111B 点亮LED6~LED8
case 6:PORTB=0X3f;break;//0011 1111B 点亮LED7~LED8
case 7:PORTB=0X7f;break;//0111 1111B 点亮LED8
case 8:PORTB=0Xff;break;//1111 1111B 全熄灭
default:break;
}
}
/**********************************************************************
				   主函数						   	
**********************************************************************/
void main(void)
{
uchar i;
DDRB=0XFF;//端口设置，PB口设置为推挽1输出
PORTB=0XFF;
PORTB=0XFF;//PORTB初始化为1,灭掉所有的LED
DelayMS(10);
while(1)//程序无条件执行
{
for(i=0;i<9;i++)
{
horse(i);
DelayMS(10);//延时时间约10MS
}
for(i=7;i!=0;i--)
{
horse(i);
DelayMS(10);
}
}
}
/**********************************************************************
				                 结束					   	
**********************************************************************/